  // Hold LALT as normal, single-tap for sticky key, double-tap for toggle
  td_alt: td_alt {
      compatible = "zmk,behavior-tap-dance";
      label = "TAP_DANCE_ALT";
      #binding-cells = <0>;
      tapping-term-ms = TAP_DANCE_MS;
      bindings = <&kp LALT>, <&sk LALT>, <&kt LALT>;
  };

  // Hold RCTRL as normal, single-tap for sticky key, double-tap for toggle
  td_ctrl: td_ctrl {
      compatible = "zmk,behavior-tap-dance";
      label = "TAP_DANCE_CTRL";
      #binding-cells = <0>;
      tapping-term-ms = TAP_DANCE_MS;
      bindings = <&kp RCTRL>, <&sk RCTRL>, <&kt RCTRL>;
  };

  // Hold as normal, tap for sticky key
  htps: hold_tap_press_sticky {
      compatible = "zmk,behavior-hold-tap";
      label = "HOLD_TAP_PRESS_STICKY";
      #binding-cells = <2>;
      tapping-term-ms = TAP_DANCE_MS;
      quick_tap_ms = <175>;
      flavor = "balanced";
      bindings = <&kp>, <&sk>;
  };

  // Test of tap dance behavior
  td_test: td_test {
      compatible = "zmk,behavior-tap-dance";
      label = "TAP_DANCE_TEST";
      #binding-cells = <0>;
      tapping-term-ms = TAP_DANCE_MS;
      bindings = <&kp N1>, <&kp N2>, <&kp N3>;
  };
